#include "charybdis.dtsi"
#include "charybdis_3610.dtsi"
#include "split_input_common.dtsi"

&kscan0 {
  compatible = "zmk,kscan-gpio-matrix";
  
  // 4行5列用に変更されたGPIO設定
  col-gpios
    = <&gpio0 9 GPIO_ACTIVE_HIGH>  // 列4
    , <&gpio0 10 GPIO_ACTIVE_HIGH>  // 列3
    , <&xiao_d 6 GPIO_ACTIVE_HIGH>  // 列2
    , <&xiao_d 5 GPIO_ACTIVE_HIGH>  // 列1
    , <&xiao_d 4 GPIO_ACTIVE_HIGH>   // 列0
    ;

  row-gpios
    = <&xiao_d 0 (GPIO_ACTIVE_HIGH | GPIO_PULL_DOWN)>   // 行0
    , <&xiao_d 1 (GPIO_ACTIVE_HIGH | GPIO_PULL_DOWN)>   // 行1
    , <&xiao_d 2 (GPIO_ACTIVE_HIGH | GPIO_PULL_DOWN)>   // 行2
    , <&xiao_d 3 (GPIO_ACTIVE_HIGH | GPIO_PULL_DOWN)>   // 行3
    ;
};

&spi0 {
    status = "okay";
};

&trackball_split2 {
	device = <&trackball2>;
};

&trackball_split { 
	status = "disabled"; 
};
